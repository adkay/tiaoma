#include "sys.h"
#include "usart1.h"
#include "usart2.h"
#include "delay.h"
#include "usart3.h"
#include "usart4.h"
#include "string.h"
#include "stdarg.h"	 	 
#include "stdio.h"	

u8 USART2_RX_BUF[USART2_REC_LEN];
u16 USART2_RX_STA;
u8 USART2_TX_BUF[1024];
u8 datah[478]={0x53,0x49,0x5A,0x45,0x20,0x31,0x30,0x30,0x20,0x6D,0x6D,0x2C,0x31,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0x0D,0x0A};
u8 datal[15]={0x22,0x0D,0x0A,0x50,0x52,0x49,0x4E,0x54,0x20,0x31,0x2C,0x31,0x0D,0x0A};	

/*
SIZE 100 mm,100 mm
GAP 2 mm,0
CLS
BOX 20,200,780,780,5
BAR 20,276,760,4
BAR 20,352,760,4
BAR 20,428,760,4
BAR 20,504,760,4
BAR 20,580,760,4
BAR 398,276,4,304
PUTBMP 150,50,"longli.BMP"
PUTBMP 50,50,"logo.BMP"
PUTBMP 30,220,"pihao.BMP"
PUTBMP 30,296,"guige.BMP"
PUTBMP 30,372,"dengji.BMP"
PUTBMP 30,448,"tongshu.BMP"
PUTBMP 30,524,"date.BMP"
PUTBMP 410,298,"shase.BMP"
PUTBMP 410,376,"guanse.BMP"
PUTBMP 410,450,"maozhong.BMP"
PUTBMP 410,528,"jingzhon.BMP"

//datah


TEXT 350,230,"4",0,1,1,"TK3502"
TEXT 210,305,"4",0,1,1,"150/40"
TEXT 270,355,"FONT001",0,3,3,"优"
TEXT 290,460,"4",0,1,1,"6"
TEXT 200,530,"4",0,1,1,"14/11/18"
TEXT 580,278,"FONT001",0,3,3,"白"
TEXT 575,358,"FONT001",0,3,3,"墨绿"
TEXT 610,460,"6",0,1,1,"25"
TEXT 610,540,"6",0,1,1,"22.5"
BARCODE 80,620,"EAN128",96,1,0,3,5,"TK350211002100014


"
PRINT 1,1  //datal












*/








void send_u2(void)
{
	u16 i=0;
	//u2_sendstr(data1,508);
	
	int a=0;
	float b=0;
	a=jinzhong;
	b=(jinzhong-a)*10;
	for(i=0;i<477;i++)u2_send(datah[i]);
	//u2_printf("DIRECTION 1 \r\n");
	u2_printf("TEXT 350,230,\"4\",0,1,1,\"");
	u2_printf("%s",pihao);
	u2_printf("\"\r\nTEXT 210,305,\"3\",0,1,1,\"");
	u2_printf("%s",guige);
	u2_printf("\"\r\nTEXT 270,355,\"FONT001\",0,3,3,\"");
	u2_printf("%s",dengji);
	u2_printf("\"\r\nTEXT 290,460,\"4\",0,1,1,\"");
	u2_printf("%d",tongshu);
	u2_printf("\"\r\nTEXT 200,530,\"4\",0,1,1,\"");
	u2_printf("%s",riqi);
	u2_printf("\"\r\nTEXT 580,278,\"FONT001\",0,3,3,\"");
	u2_printf("%s",shase);
	u2_printf("\"\r\nTEXT 575,358,\"FONT001\",0,3,3,\"");
	u2_printf("%s",guanse);
	u2_printf("\"\r\nTEXT 610,460,\"4\",0,1,1,\"");
	u2_printf("%.1f",weight);
	u2_printf("\"\r\nTEXT 610,520,\"4\",0,1,2,\"");
	u2_printf("%.1f",weight-tongzong);
	u2_printf("\"\r\nBARCODE 115,620,\"EAN128\",96,1,0,3,7,\"");
	u2_printf("%s",id);
	u2_printf("%s",numid);
	u2_printf("Z");
	u2_printf("%d",a);
	u2_printf("K");
	u2_printf("%d",(int)(b));
	u2_sendstr(datal,14);
}




	void u2_printf(char* fmt,...)  
{  
	
	
	u8 i,len;
	va_list ap;
	va_start(ap,fmt);
	vsprintf((char*)USART2_TX_BUF,fmt,ap);
	va_end(ap);
	len = strlen((const char*)USART2_TX_BUF);
		
		for(i=0;i<len;i++)
		{
			USART2->DR=USART2_TX_BUF[i];
			while((USART2->SR&0X40)==0);
		}
}
	
void u2_sendstr(u8 buf[],u16 len)
	{
		u8 i;
		for(i=0;i<len;i++)
		{
			u2_send(buf[i]);
		}
	}
void u2_send(u8 P)
	{
		
			USART2->DR=P;
			while((USART2->SR&0X40)==0);
		
	}
	
void USART2_IRQHandler(void)
		{
			u8 res;
			if(USART2->SR&(1<<5))
			{
				res=USART2->DR;
				if((USART2_RX_STA&0x8000)==0)
				{
					if(USART2_RX_STA&0x4000)
					{
						if(res==0x0D)USART2_RX_STA|=0X8000;
						else
						{
							USART2_RX_BUF[USART2_RX_STA&0X3FFF]=res;
							USART2_RX_STA++;
							if((USART2_RX_STA&0X3FFF)>USART2_REC_LEN-1)USART2_RX_STA=0;
							
						}
						

						}else
						{
							if(res==0x7E)USART2_RX_STA|=0X4000;
								
					}
				}
			}
		}
		
		
void uart2_init(u32 pclk2,u32 bound)  
{  	 
	float temp;
	u16 mantissa;
	u16 fraction;	   
	u16 i;
	temp=(float)(pclk2*1000000)/(bound*16);//得到USARTDIV
	mantissa=temp;				 //得到整数部分
	fraction=(temp-mantissa)*16; //得到小数部分	 
    mantissa<<=4;
	mantissa+=fraction; 
	RCC->APB2ENR|=1<<2;   //使能PORTA口时钟  
	RCC->APB1ENR|=1<<17;  //使能串口时钟 
	GPIOA->CRL&=0XFFFF00FF;//IO状态设置
	GPIOA->CRL|=0X00008B00;//IO状态设置
		  
	RCC->APB1RSTR|=1<<17;   //复位串口1
	RCC->APB1RSTR&=~(1<<17);//停止复位	   	   
	//波特率设置
 	USART2->BRR=mantissa; // 波特率设置	 
	USART2->CR1|=0X200C;  //1位停止,无校验位.
	USART2->CR1|=1<<8;    //PE中断使能
	USART2->CR1|=1<<5;    //接收缓冲区非空中断使能	  
	USART2->CR3=1<<7;	
	MY_NVIC_Init(3,3,USART2_IRQChannel,2);//组2，最低优先级 
	//for(i=0;i<508;i++)USART2_TX_BUF[i]=data1[i];
}

